/*
 * Linker script for the GPGPU.
 *
 * Generated from resolved architecture ${architecture}.
 * The RTL has separate instruction and data memories, but the RISC-V cores still
 * use ordinary byte addresses for loads/stores. Host-side DMEM commands use
 * word offsets, so byte address A corresponds to host DMEM word A / ${architecture.memory.word_bytes}.
 */
OUTPUT_ARCH(riscv)
ENTRY(_start)

MEMORY
{
    /* ${architecture.memory.imem.words} instructions / ${architecture.memory.dmem.words} data words. */
    IMEM (rx)  : ORIGIN = ${architecture.memory.imem.origin.hex}, LENGTH = ${architecture.memory.imem.bytes.length}
    DMEM (rw)  : ORIGIN = ${architecture.memory.dmem.origin.hex}, LENGTH = ${architecture.memory.dmem.bytes.length}
}

/* Host/kernel ABI windows, expressed as RISC-V byte addresses. */
__gpu_args_base      = ${architecture.abi.args.base_byte.hex}; /* host DMEM word ${architecture.abi.args.base_word} */
__gpu_args_end       = ${architecture.abi.args.end_byte.hex}; /* words ${architecture.abi.args.base_word}..${architecture.abi.args.end_word.last} */

/* Per-lane spill stacks: ${architecture.rtl.thread.count} lanes * ${architecture.abi.stack.per_lane_bytes} bytes = DMEM[${architecture.abi.stack.bottom_word}..${architecture.abi.stack.top_word.last}]. */
__gpu_num_cores      = ${architecture.rtl.thread.count};
__gpu_stack_stride   = ${architecture.abi.stack.per_lane_bytes};
__gpu_stack_bottom   = ${architecture.abi.stack.bottom_byte.hex};
__stack_top          = ${architecture.abi.stack.top_byte.hex};

/*
 * Compiler-owned data.
 *
 * Starts at ${architecture.abi.data.base_byte.hex}, available for .rodata/.sdata/.data/.bss.
 */
__gpu_data_base      = ${architecture.abi.data.base_byte.hex};
__gpu_data_limit     = __gpu_stack_bottom;

SECTIONS
{
    . = ORIGIN(IMEM);

    .text :
    {
        /* Put reset/entry code at PC 0 when built with -ffunction-sections. */
        KEEP(*(.text.start .text.start.*))
        KEEP(*(.text._start))
        *(.text .text.*)
    } > IMEM

    /*
     * Move the DMEM location counter to the compiler-owned data region.
     * This keeps compiler-generated data away from the host argument window.
     */
    . = __gpu_data_base;
    . = ALIGN(4);
    PROVIDE(__data_start = .);

    .rodata ALIGN(4) :
    {
        *(.srodata .srodata.*)
        *(.rodata .rodata.*)
    } > DMEM

    .sdata ALIGN(4) :
    {
        *(.sdata .sdata.*)
    } > DMEM

    .data ALIGN(4) :
    {
        *(.data .data.*)
    } > DMEM

    .bss ALIGN(4) (NOLOAD) :
    {
        PROVIDE(__bss_start = .);
        *(.sbss .sbss.*)
        *(.bss .bss.*)
        *(COMMON)
        . = ALIGN(4);
        PROVIDE(__bss_end = .);
    } > DMEM

    PROVIDE(__data_end = .);

    /DISCARD/ :
    {
        *(.comment)
        *(.riscv.attributes)
        *(.note .note.*)
        *(__patchable_function_entries)
    }
}

ASSERT(SIZEOF(.text) <= LENGTH(IMEM), "GPGPU IMEM overflow: program has more than ${architecture.memory.imem.words} instructions/${architecture.memory.imem.bytes} bytes");
ASSERT(__data_end <= __gpu_data_limit, "GPGPU DMEM overflow: compiler data/bss collides with per-lane stack window");
ASSERT(__gpu_args_end <= __gpu_data_base, "GPGPU ABI error: data region collides with argument window");
